## tools/scripts/versal2/qemu/el3/el3.its
```
/dts-v1/;
/*
 * el3.its - FIT source for the versal2 EL3 QEMU test (test_el3.sh).
 *
 * With VERSAL2_EL3=1 wolfBoot starts at EL3, checks this signed FIT, loads
 * BL31 from the "atf" image and jumps to it. BL31 then starts kernel-1 at
 * EL2. Upstream versal2 TF-A takes no handoff data, so kernel-1's load and
 * entry must equal TF-A's PRELOADED_BL33_BASE and wolfBoot's
 * VERSAL2_BL33_BASE (0x30000000 here).
 *
 * test_el3.sh fills in @BUILDDIR@ and @BL33@ before running mkimage.
 *
 *   kernel-1  test-app (image.bin, linked at 0x30000000), load/entry @BL33@
 *   atf       TF-A BL31 (bl31.bin), load/entry 0x1600000 (TF-A MEM_BASE)
 */
/ {
	description = "AMD Versal Gen 2 (VEK385) - wolfBoot EL3 test";
	#address-cells = <1>;

	images {
		kernel-1 {
			description = "wolfBoot test-app (BL33)";
			data = /incbin/("@BUILDDIR@/app.bin");
			type = "kernel";
			arch = "arm64";
			os = "linux";
			compression = "none";
			load = <@BL33@>;
			entry = <@BL33@>;
			hash-1 {
				algo = "sha256";
			};
		};
		atf {
			description = "TF-A BL31";
			data = /incbin/("@BUILDDIR@/bl31.bin");
			type = "firmware";
			arch = "arm64";
			compression = "none";
			load = <0x1600000>;
			entry = <0x1600000>;
			hash-1 {
				algo = "sha256";
			};
		};
	};

	configurations {
		default = "conf-el3";
		conf-el3 {
			description = "wolfBoot EL3 -> BL31 -> test-app";
			kernel = "kernel-1";
			loadables = "atf";
		};
	};
};
```

## tools/scripts/versal2/qemu/linux/linux.its
```
/dts-v1/;
/*
 * linux.its - U-Boot FIT source for the wolfBoot PR 1 "Local Linux test"
 * (plan item Q5), built by mk_fit.sh with `mkimage -f` (U-Boot's FIT
 * builder; the system dtc 1.7.2 is invoked internally by mkimage and
 * supports /incbin/).
 *
 * The `data = /incbin/("...")` paths carry the placeholders @BUILDDIR@
 * (the build directory, outside the repo) and @RAMDISK@ (the initramfs
 * filename: the FULL cpio.gz for the v1 FIT, the PLAIN cpio.gz for the
 * v2 FIT - the v1 initramfs embeds the signed v2 FIT as /v2.fit), which
 * mk_fit.sh substitutes before calling mkimage; the substituted file
 * lives in the build dir, the repo keeps only the template.
 *
 * Subimages (addresses match config/examples/versal2_vek385_linux.config):
 *   kernel-1  Image.gz          gzip (config GZIP=1; wolfBoot decompresses
 *             natively)          load/entry 0x24000000 (576 MB, low RAM;
 *                                WOLFBOOT_LOAD_KERNEL_ADDRESS=0 honors
 *                                this load/entry)
 *   fdt-1     kernel.dtb        no load property on purpose: wolfBoot
 *             (QEMU base + OSPI   relocates the FIT fdt to
 *             overlay, mk_dtb.sh) WOLFBOOT_LOAD_DTS_ADDRESS=0x1800000
 *   ramdisk-1 initramfs.cpio.gz  gzip, load 0x30000000 (768 MB;
 *                                WOLFBOOT_LOAD_RAMDISK_ADDRESS=0x30000000
 *                                also overrides it)
 *
 * The whole signed FIT is staged by wolfBoot at WOLFBOOT_LOAD_ADDRESS
 * (0x20000000); the signed image must fit the 44 MB BOOT/UPDATE
 * partition (WOLFBOOT_PARTITION_SIZE=0x2C00000) - mk_fit.sh checks.
 */
/ {
	description = "AMD Versal Gen 2 (VEK385) - wolfBoot local Linux test";
	#address-cells = <1>;

	images {
		kernel-1 {
			description = "AMD EDF Linux kernel (Image.gz, 6.18.10-xilinx)";
			data = /incbin/("@BUILDDIR@/Image.gz");
			type = "kernel";
			arch = "arm64";
			os = "linux";
			compression = "gzip";
			load = <0x24000000>;
			entry = <0x24000000>;
			hash-1 {
				algo = "sha256";
			};
		};
		fdt-1 {
			description = "QEMU amd-versal2-virt DTB + OSPI overlay";
			data = /incbin/("@BUILDDIR@/kernel.dtb");
			type = "flat_dt";
			arch = "arm64";
			compression = "none";
			hash-1 {
				algo = "sha256";
			};
		};
		ramdisk-1 {
			description = "initramfs (busybox + wbmtd + mtd-utils)";
			data = /incbin/("@BUILDDIR@/@RAMDISK@");
			type = "ramdisk";
			arch = "arm64";
			os = "linux";
			compression = "gzip";
			load = <0x30000000>;
			hash-1 {
				algo = "sha256";
			};
		};
	};

	configurations {
		default = "conf-vek385";
		conf-vek385 {
			description = "wolfBoot Q5 local Linux test (EDF kernel)";
			kernel = "kernel-1";
			fdt = "fdt-1";
			ramdisk = "ramdisk-1";
		};
	};
};
```
